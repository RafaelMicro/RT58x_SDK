
#include <stdio.h>
#include <string.h>
#include "cm3_mcu.h"

#include "project_config.h"

#include "uart_drv.h"
#include "retarget.h"

#include "crypto.h"

#include "rf_mcu_ahb.h"
#if  !MODULE_ENABLE(CRYPTO_SECP256R1_ENABLE)
#error "This project must set CRYPTO_SECP256R1_ENABLE option"
#endif

int main(void);

void SetClockFreq(void);

/*
 * Remark: UART_BAUDRATE_115200 is not 115200...Please don't use 115200 directly
 * Please use macro define  UART_BAUDRATE_XXXXXX
 */

#define PRINTF_BAUDRATE      UART_BAUDRATE_115200

#define SUBSYSTEM_CFG_PMU_MODE              0x4B0
#define SUBSYSTEM_CFG_LDO_MODE_DISABLE      0x02

#define GPIO20  20
#define GPIO21  21



void lecp_print_hex_bytes( const uint8_t *data, uint32_t size)
{
    uint32_t i = 0;


    while (i < size)
    {
        printf("0x%02X, ", data[i]);

        if ((i & 0x7) == 0x7)
        {
            printf("\n");
        }

        i++;
    }

    printf("\n");
}


void becp_print_hex_bytes( const uint8_t *data, uint32_t size)
{
    uint32_t i = 0;

    while (i < size)
    {
        printf("0x%02X, ", data[(size - 1) - i]);   /*little endian data to be print in big endian*/

        if ((i & 0x7) == 0x7)
        {
            printf("\n");
        }

        i++;
    }

    printf("\n");
}

static  uint8_t ecjpake_test_ex1[32];

static  uint8_t ecjpake_test_ex2[32];

static  uint8_t ecjpake_test_ex3[32];

static  uint8_t ecjpake_test_ex4[32];


/*
 * this is share secret... how to share the secret is out of the draft...
 *
 */
static  uint8_t ecjpake_test_password[32] =
{
    0x74, 0x68, 0x72, 0x65, 0x61, 0x64, 0x6a, 0x70,
    0x61, 0x6b, 0x65, 0x74, 0x65, 0x73, 0x74
};

static  uint32_t ecjpake_test_password_length = 15;


/*
 * in real environment, x1 x2 x3 x4 should be generated by TRNG
 * Here we use the following test case to demo only.
 * The following test vector is in membedtls test self check....
 */

static const uint8_t ecjpake_test_x1[] =
{
    0x01, 0x02, 0x03, 0x04, 0x05, 0x06, 0x07, 0x08,
    0x09, 0x0a, 0x0b, 0x0c, 0x0d, 0x0e, 0x0f, 0x10,
    0x11, 0x12, 0x13, 0x14, 0x15, 0x16, 0x17, 0x18,
    0x19, 0x1a, 0x1b, 0x1c, 0x1d, 0x1e, 0x1f, 0x21
};

static const uint8_t ecjpake_test_x2[] =
{
    0x61, 0x62, 0x63, 0x64, 0x65, 0x66, 0x67, 0x68,
    0x69, 0x6a, 0x6b, 0x6c, 0x6d, 0x6e, 0x6f, 0x70,
    0x71, 0x72, 0x73, 0x74, 0x75, 0x76, 0x77, 0x78,
    0x79, 0x7a, 0x7b, 0x7c, 0x7d, 0x7e, 0x7f, 0x81
};

static const uint8_t ecjpake_test_x3[] =
{
    0x61, 0x62, 0x63, 0x64, 0x65, 0x66, 0x67, 0x68,
    0x69, 0x6a, 0x6b, 0x6c, 0x6d, 0x6e, 0x6f, 0x70,
    0x71, 0x72, 0x73, 0x74, 0x75, 0x76, 0x77, 0x78,
    0x79, 0x7a, 0x7b, 0x7c, 0x7d, 0x7e, 0x7f, 0x81
};

static const uint8_t ecjpake_test_x4[] =
{
    0xc1, 0xc2, 0xc3, 0xc4, 0xc5, 0xc6, 0xc7, 0xc8,
    0xc9, 0xca, 0xcb, 0xcc, 0xcd, 0xce, 0xcf, 0xd0,
    0xd1, 0xd2, 0xd3, 0xd4, 0xd5, 0xd6, 0xd7, 0xd8,
    0xd9, 0xda, 0xdb, 0xdc, 0xdd, 0xde, 0xdf, 0xe1
};


static const unsigned char ecjpake_test_cli_one[] =
{
    0x41, 0x04, 0xac, 0xcf, 0x01, 0x06, 0xef, 0x85, 0x8f, 0xa2, 0xd9, 0x19,
    0x33, 0x13, 0x46, 0x80, 0x5a, 0x78, 0xb5, 0x8b, 0xba, 0xd0, 0xb8, 0x44,
    0xe5, 0xc7, 0x89, 0x28, 0x79, 0x14, 0x61, 0x87, 0xdd, 0x26, 0x66, 0xad,
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    0x8b, 0x01, 0x0e, 0x44, 0x3e, 0xf0
};

static const unsigned char ecjpake_test_srv_one[] =
{
    0x41, 0x04, 0x7e, 0xa6, 0xe3, 0xa4, 0x48, 0x70, 0x37, 0xa9, 0xe0, 0xdb,
    0xd7, 0x92, 0x62, 0xb2, 0xcc, 0x27, 0x3e, 0x77, 0x99, 0x30, 0xfc, 0x18,
    0x40, 0x9a, 0xc5, 0x36, 0x1c, 0x5f, 0xe6, 0x69, 0xd7, 0x02, 0xe1, 0x47,
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    0xec, 0x00, 0xc2, 0xc9, 0xeb, 0x12
};

static const unsigned char expect_ecjpake_test_pms[] =
{
    0xf3, 0xd4, 0x7f, 0x59, 0x98, 0x44, 0xdb, 0x92, 0xa5, 0x69, 0xbb, 0xe7,
    0x98, 0x1e, 0x39, 0xd9, 0x31, 0xfd, 0x74, 0x3b, 0xf2, 0x2e, 0x98, 0xf9,
    0xb4, 0x38, 0xf7, 0x19, 0xd3, 0xc4, 0xf3, 0x51
};



/************************************************************/

/*this is pin mux setting*/
void Init_Default_Pin_Mux(void)
{
    /*set gpio 20 21 for debug used*/
    pin_set_mode(GPIO20, MODE_GPIO);
    pin_set_mode(GPIO21, MODE_GPIO);


    /*uart2 pinmux*/
    pin_set_mode(16, MODE_UART);     /*GPIO16 as UART0 TX*/
    pin_set_mode(17, MODE_UART);     /*GPIO17 as UART0 RX*/

    /*2022/05/09 FPGA no UART2... maybe it will add later...*/
    //pin_set_mode(6, MODE_UART);      /*GPIO6 as UART2 TX*/
    //pin_set_mode(31, MODE_UART);     /*GPIO31 as UART2 RX*/

    return;
}

void Comm_Subsystem_Disable_LDO_Mode(void)
{
    uint8_t reg_buf[4];

    RfMcu_MemoryGetAhb(SUBSYSTEM_CFG_PMU_MODE, reg_buf, 4);
    reg_buf[0] &= ~SUBSYSTEM_CFG_LDO_MODE_DISABLE;
    RfMcu_MemorySetAhb(SUBSYSTEM_CFG_PMU_MODE, reg_buf, 4);
}

/*
 * we force random number .. this is not true random number... just test
 * this function will be remove...
 *
 * Notice: this function will return big endian random number
 *
 *   maxim length is 128 bytes.
 *
 */
void self_test_rng(uint8_t *out, uint32_t length )
{
    static uint8_t entropy_input[32] =
    {
        0x05, 0xac, 0x9f, 0xc4, 0xc6, 0x2a, 0x02, 0xe3, 0xf9, 0x08, 0x40, 0xda, 0x56, 0x16, 0x21, 0x8c,
        0x6d, 0xe5, 0x74, 0x3d, 0x66, 0xb8, 0xe8, 0xfb, 0xf8, 0x33, 0x75, 0x9c, 0x59, 0x28, 0xb5, 0x3d
    };

    static uint8_t nonce[16] =
    {
        0x2b, 0x89, 0xa1, 0x79, 0x04, 0x92, 0x2e, 0xd8, 0xfa, 0x17, 0xa6, 0x30, 0x44, 0x84, 0x85, 0x45
    };

    static uint8_t entropy_input_reseed[32] =
    {
        0x27, 0x91, 0x12, 0x6b, 0x8b, 0x52, 0xef, 0x1f, 0xd9, 0x39, 0x2a, 0x0a, 0x13, 0xe0, 0x08, 0x3b,
        0xed, 0x41, 0x86, 0xdc, 0x55, 0x9b, 0x23, 0x96, 0x07, 0xac, 0x70, 0xec, 0x8d, 0xce, 0xcf, 0x9b
    };

    static uint8_t additional_input_reseed[32] =
    {
        0x43, 0xba, 0xc1, 0x3b, 0xae, 0x71, 0x50, 0x92, 0xcf, 0x7e, 0xb2, 0x80, 0xa2, 0xe1, 0x0a, 0x96,
        0x2f, 0xaf, 0x72, 0x39, 0xc4, 0x76, 0x12, 0xf6, 0x9b, 0xcB, 0x4a, 0x35, 0xa5, 0x84, 0xe5, 0x4c
    };

    static uint8_t additional_input[2][32] =
    {
        {
            0x3f, 0x2f, 0xed, 0x4b, 0x68, 0xd5, 0x06, 0xec, 0xef, 0xa2, 0x1f, 0x3f, 0x5b, 0xb9, 0x07, 0xCE,
            0xb0, 0xf1, 0x7d, 0xbc, 0x30, 0xf6, 0xff, 0xbb, 0xa5, 0xe5, 0x8D, 0x14, 0x08, 0xc5, 0x3a, 0x1e
        },
        {
            0x52, 0x90, 0x30, 0xdf, 0x50, 0xf4, 0x10, 0x98, 0x5f, 0xde, 0x06, 0x8d, 0xf8, 0x2b, 0x93, 0x5e,
            0xc2, 0x3d, 0x83, 0x9c, 0xb4, 0xb2, 0x69, 0x41, 0x4c, 0x0e, 0xde, 0x6c, 0xff, 0xea, 0x5b, 0x68
        }
    };

    uint32_t *ptr,  *p_result;

    uint8_t  *pb_ptr;

    /*No PersonalizationString*/

    hmac_drbg_state    hmac_drbg_ctx;

    uint8_t seed_material[64];

    static uint8_t    result[128];      /*a buffer to save random bumber*/

    uint32_t     i;

    static uint8_t    *p_current = result;
    static uint32_t   remain_length = 0;

    if (remain_length >= length)
    {
        memcpy(out, p_current, length);
        p_current += length;
        remain_length -= length;
    }
    else
    {
        /*maybe we should use PRNG here*/

        /*regenerate new random number*/
        memcpy(seed_material, entropy_input, sizeof(entropy_input));
        memcpy(seed_material + sizeof(entropy_input), nonce, sizeof(nonce));

        hmac_drbg_instantiate(&hmac_drbg_ctx, seed_material, sizeof(entropy_input) + sizeof(nonce));

        /*drbg reseed  entropy_input+ additional_input_reseed*/

        memcpy(seed_material, entropy_input_reseed, sizeof(entropy_input_reseed));
        memcpy(seed_material + sizeof(entropy_input_reseed), additional_input_reseed, sizeof(additional_input_reseed));

        /*drbg reseed*/
        hmac_drbg_update(&hmac_drbg_ctx, (uint8_t *) seed_material, sizeof(entropy_input_reseed) + sizeof(additional_input_reseed));

        for (i = 0; i < 2; i++)
        {
            hmac_drbg_generate(result, &hmac_drbg_ctx, 128,  (uint8_t *)(additional_input[i]), 32);
        }

        p_result = (uint32_t *) result;

        /*maybe we should use PRNG HERE*/
        ptr = (uint32_t *) entropy_input;
        *ptr += *p_result++;

        pb_ptr = nonce;

        while (1)
        {

            *pb_ptr = *pb_ptr + 1;  /*increase one for next nonce*/

            if (*pb_ptr != 0)
            {
                break;      /*not overflow*/

            }

            pb_ptr++;
        }

        /*maybe we should use PRNG HERE*/
        ptr = (uint32_t *) entropy_input_reseed;
        *ptr += *p_result++;

        ptr = (uint32_t *) additional_input_reseed;
        *ptr += *p_result++;

        ptr = (uint32_t *) & (additional_input[0]);
        *ptr += *p_result++;

        ptr = (uint32_t *) & (additional_input[1]);
        *ptr += *p_result++;


        p_current = result;
        remain_length = 128;

        memcpy(out, p_current, length);
        p_current += length;
        remain_length -= length;

    }

    return;
}


/*
 * Notice: this is just for demo...so we allocate it in memory
 * in real application, this structure is very large, so it
 * should allocate dynamic in heap to save space...
 *
 */

ECJPAKE_CTX   ecjpake_server_ctx;

ECJPAKE_CTX   ecjpake_client_ctx;


ECJPAKEKeyKP  key_X1, key_X2, key_X3, key_X4;


uint32_t test_ecjpake_client_create_zkp()
{
    ECPoint_P256   *genx;

    // printf("test_ecjpake_client_create_zkp \n");

    /*save x1 x2 to client private key --- notice they are BIG ENDIAN*/
    memcpy( ecjpake_client_ctx.private_key_x1, ecjpake_test_ex1, sizeof(ecjpake_test_ex1));
    memcpy( ecjpake_client_ctx.private_key_x2, ecjpake_test_ex2, sizeof(ecjpake_test_ex2));

    genx = (ECPoint_P256 *) &Curve_Gx_p256_BE;   /*big endian*/

    /*client ecjpake ctx*/
    ecjpake_generate_zkp( &ecjpake_client_ctx, &key_X1, (ECPoint_P256 *) genx, ecjpake_client_ctx.private_key_x1);
    ecjpake_generate_zkp( &ecjpake_client_ctx, &key_X2, (ECPoint_P256 *) genx, ecjpake_client_ctx.private_key_x2);

    /*Here we should save key_X1 and key_X2 public key to self public key X1 X2..*/

    return STATUS_SUCCESS;
}

uint32_t   test_ecjpake_server_create_zkp()
{
    ECPoint_P256   *genx;

    //printf("test_ecjpake_server_create_zkp \n");

    /*save x3 x4 to server private key --- notice they are BIG ENDIAN*/
    memcpy( ecjpake_server_ctx.private_key_x1, ecjpake_test_ex3, sizeof(ecjpake_test_ex3));
    memcpy( ecjpake_server_ctx.private_key_x2, ecjpake_test_ex4, sizeof(ecjpake_test_ex4));

    genx = (ECPoint_P256 *) &Curve_Gx_p256_BE;   /*big endian*/

    /*server ecjpake ctx*/
    ecjpake_generate_zkp( &ecjpake_server_ctx, &key_X3, (ECPoint_P256 *) genx, ecjpake_server_ctx.private_key_x1);

    ecjpake_generate_zkp( &ecjpake_server_ctx, &key_X4, (ECPoint_P256 *) genx, ecjpake_server_ctx.private_key_x2);

    /*Here we should save key_X3 and key_X4 public key to self public key X1 X2..*/

    return STATUS_SUCCESS;
}

uint32_t   test_ecjpake_client_verify_zkp()
{
    ECPoint_P256   *genx;
    uint32_t  status;

    //printf("test_ecjpake_client_verify_zkp \n");

    genx = (ECPoint_P256 *) &Curve_Gx_p256_BE;   /*big endian*/

    /*Here we assume Key_X1 or KeyX2 come from server hello packet.*/
    status = ecjpake_verify_zkp(&ecjpake_client_ctx, genx, &key_X3);

    if (status != STATUS_SUCCESS)
    {
        printf("Oops....ecjpake_verify_zkp client error  1\n ");
        while (1);
    }

    status = ecjpake_verify_zkp(&ecjpake_client_ctx, genx, &key_X4);

    if (status != STATUS_SUCCESS)
    {
        printf("Oops....ecjpake_verify_zkp client error 2 \n ");
        while (1);
    }

    /*Here we should save key_X3 and key_X4 public key to client peer public key X3 X4..*/

    return STATUS_SUCCESS;
}


uint32_t test_ecjpake_server_verify_zkp()
{
    ECPoint_P256   *genx;
    uint32_t  status;

    //printf("test_ecjpake_server_verify_zkp \n");

    genx = (ECPoint_P256 *) &Curve_Gx_p256_BE;   /*big endian*/

    /*Here we assume Key_X3 or KeyX4 come from client hello packet.*/
    status = ecjpake_verify_zkp(&ecjpake_server_ctx, genx, &key_X1);

    if (status != STATUS_SUCCESS)
    {
        printf("Oops....ecjpake_verify_zkp server error 1 \n ");
        while (1);
    }

    status = ecjpake_verify_zkp(&ecjpake_server_ctx, genx, &key_X2);

    if (status != STATUS_SUCCESS)
    {
        printf("Oops....ecjpake_verify_zkp server error 2 \n ");
        while (1);
    }

    /*Here we should save key_X1 and key_X2 public key to server peer public key X3 X4..*/

    return STATUS_SUCCESS;
}


void test_mbedtls_pattern()
{

    ECPoint_P256   *genx;

    uint32_t       status, secret_length;

    uint8_t        server_pms[secp256r1_op_num_in_byte], client_pms[secp256r1_op_num_in_byte];

    printf("=================================================== \n");
    printf("below is membedtls test example pattern              \n");
    printf("because we don't know mebedtls random number so something we do not check.. \n");
    printf("=================================================== \n");

    ecjpake_client_ctx.role = client_role;          /*client id*/
    ecjpake_server_ctx.role = server_role;          /*server id*/


    /*copy share secret to client_ctx server_ctx*/

    memset( ecjpake_client_ctx.secret, 0, secp256r1_op_num_in_byte);
    memset( ecjpake_server_ctx.secret, 0, secp256r1_op_num_in_byte);

    secret_length = ecjpake_test_password_length;

    if (secret_length <= secp256r1_op_num_in_byte)
    {
        /*Notice: secret is big endian... so padding zero in header...not tail.*/
        memcpy( ecjpake_client_ctx.secret + (secp256r1_op_num_in_byte - secret_length),
                ecjpake_test_password, ecjpake_test_password_length);

        memcpy( ecjpake_server_ctx.secret + (secp256r1_op_num_in_byte - secret_length),
                ecjpake_test_password, ecjpake_test_password_length);
    }
    else
    {
        /*only copy the first 32 bytes for share secret ??*/
        memcpy(ecjpake_client_ctx.secret, ecjpake_test_password, secp256r1_op_num_in_byte);
        memcpy(ecjpake_server_ctx.secret, ecjpake_test_password, secp256r1_op_num_in_byte);
    }

    /*copy private key to client_ctx*/

    memcpy( ecjpake_client_ctx.private_key_x1, ecjpake_test_x1, secp256r1_op_num_in_byte);
    memcpy( ecjpake_client_ctx.private_key_x2, ecjpake_test_x2, secp256r1_op_num_in_byte);

    /*copy private key to server_ctx*/

    memcpy( ecjpake_server_ctx.private_key_x1, ecjpake_test_x3, secp256r1_op_num_in_byte);
    memcpy( ecjpake_server_ctx.private_key_x2, ecjpake_test_x4, secp256r1_op_num_in_byte);

    genx = (ECPoint_P256 *) &Curve_Gx_p256_BE;    /*big endian*/

    /*temp create a key_X1 to verify zkp*/
    memcpy(key_X1.X.x,  (uint8_t *) &ecjpake_test_cli_one[2], 0x20);
    memcpy(key_X1.X.y,  (uint8_t *) &ecjpake_test_cli_one[0x22], 0x20);

    memcpy(key_X1.zkp.V.x,  (uint8_t *) &ecjpake_test_cli_one[0x44], 0x20);
    memcpy(key_X1.zkp.V.y,  (uint8_t *) &ecjpake_test_cli_one[0x64], 0x20);

    memcpy(key_X1.zkp.r,  (uint8_t *) &ecjpake_test_cli_one[0x85], 0x20);

    /*save self public key to ecjpake_ctx X1 --- this step should be done in ecjpake_generate_zkp */
    memcpy((uint8_t *) & (ecjpake_client_ctx.ecc_point_X1), (uint8_t *) & (key_X1.X), (secp256r1_op_num_in_byte << 1));

    status = ecjpake_verify_zkp(&ecjpake_server_ctx, genx, &key_X1);

    if (status != STATUS_SUCCESS)
    {
        printf("Oops....ecjpake_verify_zkp error cleint 1 \n ");
        while (1);
    }

    /*save peer Public key to ecjpake_server_ctx  X3 */
    memcpy((uint8_t *) & (ecjpake_server_ctx.ecc_point_X3), (uint8_t *) & (key_X1.X), (secp256r1_op_num_in_byte << 1));

    printf("----------------------------------------\n\n");


    memcpy(key_X2.X.x,  (uint8_t *) &ecjpake_test_cli_one[0xA7], 0x20);
    memcpy(key_X2.X.y,  (uint8_t *) &ecjpake_test_cli_one[0xC7], 0x20);

    memcpy(key_X2.zkp.V.x,  (uint8_t *) &ecjpake_test_cli_one[0xE9], 0x20);
    memcpy(key_X2.zkp.V.y,  (uint8_t *) &ecjpake_test_cli_one[0x109], 0x20);

    memcpy(key_X2.zkp.r,  (uint8_t *) &ecjpake_test_cli_one[0x12A], 0x20);

    /*save self public key to ecjpake_ctx X1 --- this step should be done in ecjpake_generate_zkp */
    memcpy((uint8_t *) & (ecjpake_client_ctx.ecc_point_X2), (uint8_t *) & (key_X2.X), (secp256r1_op_num_in_byte << 1));

    status = ecjpake_verify_zkp(&ecjpake_server_ctx, genx, &key_X2);

    if (status != STATUS_SUCCESS)
    {
        printf("Oops....ecjpake_verify_zkp error cleint 2\n ");
        while (1);
    }

    /*save peer Public key to ecjpake_server_ctx  X4 */
    memcpy((uint8_t *) & (ecjpake_server_ctx.ecc_point_X4), (uint8_t *) & (key_X2.X), (secp256r1_op_num_in_byte << 1));

    printf("************************************************\n\n");

    memcpy(key_X3.X.x,  (uint8_t *) &ecjpake_test_srv_one[2], 0x20);
    memcpy(key_X3.X.y,  (uint8_t *) &ecjpake_test_srv_one[0x22], 0x20);

    memcpy(key_X3.zkp.V.x,  (uint8_t *) &ecjpake_test_srv_one[0x44], 0x20);
    memcpy(key_X3.zkp.V.y,  (uint8_t *) &ecjpake_test_srv_one[0x64], 0x20);

    memcpy(key_X3.zkp.r,  (uint8_t *) &ecjpake_test_srv_one[0x85], 0x20);

    /*save self public key to ecjpake_ctx X1 --- this step should be done in ecjpake_generate_zkp */
    memcpy((uint8_t *) & (ecjpake_server_ctx.ecc_point_X1), (uint8_t *) & (key_X3.X), (secp256r1_op_num_in_byte << 1));

    status = ecjpake_verify_zkp(&ecjpake_client_ctx, genx, &key_X3);

    if (status != STATUS_SUCCESS)
    {
        printf("Oops....ecjpake_verify_zkp error server 1 \n ");
        while (1);
    }

    /*save peer Public key to ecjpake_client_ctx  X3 */
    memcpy((uint8_t *) & (ecjpake_client_ctx.ecc_point_X3), (uint8_t *) & (key_X3.X), (secp256r1_op_num_in_byte << 1));

    printf("%%%%%%%%%%%%%%%%%%%%%%%%%%%%%%%%%%%%%%%%%%%%%%%%%%\n\n");

    memcpy(key_X4.X.x,  (uint8_t *) &ecjpake_test_srv_one[0xA7], 0x20);
    memcpy(key_X4.X.y,  (uint8_t *) &ecjpake_test_srv_one[0xC7], 0x20);

    memcpy(key_X4.zkp.V.x,  (uint8_t *) &ecjpake_test_srv_one[0xE9], 0x20);
    memcpy(key_X4.zkp.V.y,  (uint8_t *) &ecjpake_test_srv_one[0x109], 0x20);

    memcpy(key_X4.zkp.r,  (uint8_t *) &ecjpake_test_srv_one[0x12A], 0x20);


    /*save self public key to ecjpake_ctx X2 --- this step should be done in ecjpake_generate_zkp */
    memcpy((uint8_t *) & (ecjpake_server_ctx.ecc_point_X2), (uint8_t *) & (key_X4.X), (secp256r1_op_num_in_byte << 1));

    status = ecjpake_verify_zkp(&ecjpake_client_ctx, genx, &key_X4);

    if (status != STATUS_SUCCESS)
    {
        printf("Oops....ecjpake_verify_zkp error server 2 \n ");
        while (1);
    }

    /*save peer Public key to ecjpake_client_ctx  X4 */
    memcpy((uint8_t *) & (ecjpake_client_ctx.ecc_point_X4), (uint8_t *) & (key_X4.X), (secp256r1_op_num_in_byte << 1));

    /*step2 ... create client step2 zkp.. reuse key_X1 for saving memory buffer*/
    ecjpake_generate_step2_zkp(&ecjpake_client_ctx, &key_X1);

    /*step2 ... client send key_X1 zkp to server, server verify step2 zkp.*/
    ecjpake_verify_step2_zkp(&ecjpake_server_ctx, &key_X1);

    ecjpake_compute_key(&ecjpake_server_ctx, &key_X1, server_pms);



    /*step2 ... create server step2 zkp.. reuse key_X3 for saving memory buffer*/
    ecjpake_generate_step2_zkp(&ecjpake_server_ctx, &key_X3);

    /*step2 ... server send key_X3 zkp to client, client verify step2 zkp.*/
    ecjpake_verify_step2_zkp(&ecjpake_client_ctx, &key_X3);

    ecjpake_compute_key(&ecjpake_client_ctx, &key_X3, client_pms);

    if (memcmp(server_pms, client_pms, secp256r1_op_num_in_byte) != 0)
    {
        printf(" OOPS.. PMS is not match?? ");
        while (1);
    }

    if (memcmp(server_pms, expect_ecjpake_test_pms, secp256r1_op_num_in_byte) != 0)
    {
        printf(" OOPS.. Caculate PMS is not match expect?? ");
        while (1);
    }

}

int main(void)
{
    uint32_t       status, secret_length;

    uint8_t        server_pms[secp256r1_op_num_in_byte], client_pms[secp256r1_op_num_in_byte];

    uint32_t       i, j = 8;

    /*we should set pinmux here or in SystemInit */
    Change_Ahb_System_Clk(SYS_48MHZ_CLK);

    Init_Default_Pin_Mux();

    /*init debug uart port for printf*/
    console_drv_init(PRINTF_BAUDRATE);

    Comm_Subsystem_Disable_LDO_Mode();//if don't load 569 FW, need to call the function.

    /*init software sha256 vector*/
    sha256_vector_init();

    printf("Hello Crypto ECJPAKE %s %s\n", __DATE__, __TIME__);


    /*this is the pattern verctor we can get from internet*/
    test_mbedtls_pattern();

    printf("=============================================================\n");
    printf("below test case is random generate test pattern\n");
    printf("client and server should have the same pms \n");
    printf("=============================================================\n");

    ecjpake_client_ctx.role = client_role;          /*client id*/
    ecjpake_server_ctx.role = server_role;          /*server id*/

    for (i = 0; i < 100; i++)
    {

        printf("test round %ld \n\n\n\n", i);
        printf("=============================================================\n");

        /*create random share secret and x1 x2 x3 x4*/

        self_test_rng( ecjpake_test_ex1, 32);
        self_test_rng( ecjpake_test_ex2, 32);
        self_test_rng( ecjpake_test_ex3, 32);
        self_test_rng( ecjpake_test_ex4, 32);

        self_test_rng( ecjpake_test_password, j);

        /*
         * Notice:
         * share secret may be less than 32 bytes... if it less than 32 bytes
         * we will add zero padding before share secret to be 32 bytes
         */

        memset( ecjpake_client_ctx.secret, 0, secp256r1_op_num_in_byte);
        memset( ecjpake_server_ctx.secret, 0, secp256r1_op_num_in_byte);

        secret_length = j;

        j++;

        if (j > 32)
        {
            /*round off to 8 bytes.*/
            j = 8;
        }

        if (secret_length <= secp256r1_op_num_in_byte)
        {
            /*Notice: secret is big endian... so padding zero in header...not tail.*/
            memcpy( ecjpake_client_ctx.secret + (secp256r1_op_num_in_byte - secret_length),
                    ecjpake_test_password, sizeof(ecjpake_test_password));

            memcpy( ecjpake_server_ctx.secret + (secp256r1_op_num_in_byte - secret_length),
                    ecjpake_test_password, sizeof(ecjpake_test_password));
        }
        else
        {
            /*only copy the first 32 bytes for share secret ??*/
            memcpy(ecjpake_client_ctx.secret, ecjpake_test_password, secp256r1_op_num_in_byte);
            memcpy(ecjpake_server_ctx.secret, ecjpake_test_password, secp256r1_op_num_in_byte);
        }


        /*create client hello messsage, excluding real protocol data.*/
        test_ecjpake_client_create_zkp();

        /*save local ECJPAKEKeyKP public key to ecjpake context public key, x and y so 64 bytes.*/
        memcpy((uint8_t *) & (ecjpake_client_ctx.ecc_point_X1), (uint8_t *) & (key_X1.X), (secp256r1_op_num_in_byte << 1));
        memcpy((uint8_t *) & (ecjpake_client_ctx.ecc_point_X2), (uint8_t *) & (key_X2.X), (secp256r1_op_num_in_byte << 1));

        /*client hello message to server*/
        test_ecjpake_server_verify_zkp();

        /*save peer ECJPAKEKeyKP public key to  ecjpake context public key, x and y so 64 bytes.*/
        memcpy((uint8_t *)  & (ecjpake_server_ctx.ecc_point_X3), (uint8_t *)  & (key_X1.X), (secp256r1_op_num_in_byte << 1));
        memcpy((uint8_t *)  & (ecjpake_server_ctx.ecc_point_X4), (uint8_t *)  & (key_X2.X), (secp256r1_op_num_in_byte << 1));

        /*create server hello messsage, excluding real protocol data.*/
        test_ecjpake_server_create_zkp();

        /*save local ECJPAKEKeyKP public key to ecjpake context, x and y so 64 bytes.*/
        memcpy((uint8_t *)  & (ecjpake_server_ctx.ecc_point_X1), (uint8_t *)  & (key_X3.X), (secp256r1_op_num_in_byte << 1));
        memcpy((uint8_t *)  & (ecjpake_server_ctx.ecc_point_X2), (uint8_t *)  & (key_X4.X), (secp256r1_op_num_in_byte << 1));

        /*server hello message to client*/
        test_ecjpake_client_verify_zkp();

        /*save peer ECJPAKEKeyKP public key to ecjpake context, x and y so 64 bytes.*/
        memcpy((uint8_t *)  & (ecjpake_client_ctx.ecc_point_X3), (uint8_t *)  & (key_X3.X), (secp256r1_op_num_in_byte << 1));
        memcpy((uint8_t *)  & (ecjpake_client_ctx.ecc_point_X4), (uint8_t *)  & (key_X4.X), (secp256r1_op_num_in_byte << 1));


        /*step2 ... create client step2 zkp.. reuse key_X1 for saving memory buffer*/
        ecjpake_generate_step2_zkp(&ecjpake_client_ctx, &key_X1);

        /*step2 ... client send key_X1 zkp to server, server verify step2 zkp.*/
        status = ecjpake_verify_step2_zkp(&ecjpake_server_ctx, &key_X1);

        if (status != STATUS_SUCCESS)
        {
            printf("Oops... step2 server verify not correct\n");
            /*do something error handling...*/
        }
        else
        {
            /*server caculate share information.*/
            ecjpake_compute_key(&ecjpake_server_ctx, &key_X1, server_pms);
        }


        /*step2 ... create server step2 zkp.. reuse key_X3 for saving memory buffer*/
        ecjpake_generate_step2_zkp(&ecjpake_server_ctx, &key_X3);

        /*step2 ... server send key_X3 zkp to client, client verify step2 zkp.*/
        status = ecjpake_verify_step2_zkp(&ecjpake_client_ctx, &key_X3);

        if (status != STATUS_SUCCESS)
        {
            printf("Oops... step2 server verify not correct\n");
            /*do something error handling...*/
        }
        else
        {
            /*server caculate share information.*/
            ecjpake_compute_key(&ecjpake_client_ctx, &key_X3, client_pms);
        }

        if (memcmp(server_pms, client_pms, secp256r1_op_num_in_byte) != 0)
        {
            printf(" OOPS.. PMS is not match?? ");
            while (1);
        }



    }

    printf("finish ECC ECJPAKE crypto test\n");

    while (1);
}


void SetClockFreq(void)
{
    return;
}


